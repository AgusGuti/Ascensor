#INCLUDE <P16F628A.INC>

__CONFIG 3F10


;VARIABLES

CONT_1	EQU 0X20
CONT_2	EQU 0X21
AUX		EQU 0X22	;USADO PARA ESTADO DEL MOTOR Y COMO BANDERA DE
					;PISO DE DESTINO (6: PB ; 7: 2DO PISO)
PB_F	EQU 6
SGDO_F	EQU 7

SNSR_PRTA	EQU 3		;RB0: PUERTA DE CABINA (1 = ABIERTA)
MOTOR		EQU 1		;RB1: PRENDIDO DEL MOTOR (0 = PRENDIDO)
DIREC		EQU 2		;RB2: DIRECCION DE GIRO (0 = SUBE)	
BTN_PB		EQU	4		;BOTONERA: RB4: BOTON A PB
BTN_1ERO	EQU	5		;		   RB5: BOTON A 1ERO
BTN_2DO		EQU	6		;		   RB6: BOTON A 2DO
;SNSR_PB		EQU	0		;RA0: FIN DE CARRERA EN PB
POS_PB		EQU	0		;POSICION EN LA CABINA: RA0: PB
POS_1ERO	EQU	1		;						RA1: 1ERO
POS_2DO		EQU	2		;						RA2: 2DO


		ORG 0X00
		GOTO INICIO
		ORG 0X04
				

INICIO	
		
;SETEO

	BSF STATUS, RP0			
	MOVLW 0X0F			;PONGO RA0 A RA3 EN ENTRADA		
	MOVWF TRISA	
	MOVLW 0X71			;PONGO RB0 Y DE RB4 A RA6 EN ENTRADA
	MOVWF TRISB
	BCF STATUS, RP0

	MOVLW 0X07
	MOVWF CMCON
	
	CLRF PORTA
	BSF PORTA, 4
	CLRF PORTB
	BSF PORTB, MOTOR 
	CLRF AUX
	

;HACIA PB

	
	BTFSC PORTA, SNSR_PRTA
		CALL PARADA
	CALL INICIAL_PB

PROGRAMA
	
	BTFSC PORTA, SNSR_PRTA
		CALL PARADA

	BTFSC PORTB, BTN_PB
		CALL HACIA_PB			;PREGUNTO SISTEMATICAMENTE POR LOS PULSADORES.

	BTFSC PORTB, BTN_1ERO
		CALL HACIA_1ERO

	BTFSC PORTB, BTN_2DO
		CALL HACIA_2DO

	GOTO PROGRAMA
	

PARADA
	CALL DEMORA_20ms		;HAGO UNA DEMORA PREVISORIA
	
	BTFSC PORTB, MOTOR
		BSF AUX, 0			;GUARDO ESTADO DEL MOTOR

	BSF PORTB, MOTOR
	BTFSC PORTA, SNSR_PRTA
		GOTO $-.1			;BUCLE QUE APAGA EL MOTOR DE ESTAR ABIERTA LA PUERTA
							;(RB0 = 1) Y REANUDA EL MOTOR SI ES NECESARIO.
	BTFSS AUX, 0
		BCF PORTB, MOTOR		;RESTAURO ESTADO DEL MOTOR
	RETURN
	
	
HACIA_PB
	CALL DEMORA_20ms		;HAGO UNA DEMORA PREVISORIA
	BTFSS PORTB, BTN_PB		;SALGO SI FUE POR UN REBOTE INDESEADO
		RETURN				
	BTFSC PORTA, POS_PB		;SALGO SI EL CARRO ESTA EN EL PISO QUE SE TOCO.
		RETURN

	INICIAL_PB				;COMIENZO DE LA RUTINA DE POSICION INICIAL (SOLO LA PRIMER VEZ)

	BSF AUX, PB_F			;ACTIVO BANDERA PERSONALIZADA
	BCF AUX, SGDO_F
		
	CALL DIRECCION			;LLAMO A SUBRUTINA QUE ESTABLECE LA DIRECCION

	BTFSC PORTA, SNSR_PRTA	;PREGUNTO SI SE ABRE LA PUERTA EN EL TRAYECTO
		CALL PARADA
	BTFSS PORTA, POS_PB
		GOTO $-.3			;PREGUNTO SI LLEGO.

	BSF PORTB, MOTOR		;APAGO EL MOTOR

	;CARGO CABINA?
	
	BCF AUX, PB_F			;LIMPIO BANDERA
	BCF AUX, SGDO_F

	RETURN

HACIA_1ERO
	CALL DEMORA_20ms		;HAGO UNA DEMORA PREVISORIA
	BTFSS PORTB, BTN_1ERO	;SALGO SI FUE POR UN REBOTE INDESEADO
		RETURN				
	BTFSC PORTA, POS_1ERO	;SALGO SI EL CARRO ESTA EN EL PISO QUE SE TOCO.
		RETURN
	
	BTFSC PORTA, POS_PB
		BSF AUX, SGDO_F
	BTFSC PORTA, POS_2DO
		BSF AUX, PB_F
		
	CALL DIRECCION			;LLAMO A SUBRUTINA QUE ESTABLECE LA DIRECCION

	BTFSC PORTA, SNSR_PRTA	;PREGUNTO SI SE ABRE LA PUERTA EN EL TRAYECTO
		CALL PARADA
	BTFSS PORTA, POS_1ERO
		GOTO $-.3			;PREGUNTO SI LLEGO.

	BSF PORTB, MOTOR		;APAGO EL MOTOR

	;CARGO CABINA?
	
	BCF AUX, PB_F
	BCF AUX, SGDO_F

	RETURN

HACIA_2DO
	CALL DEMORA_20ms		;HAGO UNA DEMORA PREVISORIA
	BTFSS PORTB, BTN_2DO	;SALGO SI FUE POR UN REBOTE INDESEADO
		RETURN				
	BTFSC PORTA, POS_2DO	;SALGO SI EL CARRO ESTA EN EL PISO QUE SE TOCO.
		RETURN
	
	BCF AUX, PB_F
	BSF AUX, SGDO_F
	
	CALL DIRECCION			;LLAMO A SUBRUTINA QUE ESTABLECE LA DIRECCION

	BTFSC PORTA, SNSR_PRTA	;PREGUNTO SI SE ABRE LA PUERTA EN EL TRAYECTO
		CALL PARADA
	BTFSS PORTA, POS_2DO
		GOTO $-.3			;PREGUNTO SI LLEGO.

	BSF PORTB, MOTOR		;APAGO EL MOTOR

	;CARGO CABINA?
	
	BCF AUX, PB_F
	BCF AUX, SGDO_F
	
	RETURN


DIRECCION
	BSF PORTB, MOTOR
		
	BTFSC PORTA, POS_PB			;SI ESTA EN PB SOLO PUEDE SUBIR
		BCF PORTB, DIREC
	BTFSC PORTA, POS_2DO
		BSF PORTB, DIREC		;SI ESTA EN EL 2DO SOLO PUEDE BAJAR
		
								;SI EL CARRITO ESTA EN EL 1ERO Y SE TOCA EL 
	BTFSC AUX, PB_F				;BOTON DE PB AVANZA HACIA ABAJO, DE LO 
		BSF PORTB, DIREC		;CONTRARIO, SUBE.
	BTFSC AUX, SGDO_F				 
		BCF PORTB, DIREC
		
	BCF PORTB, MOTOR			;ARRANCO EL MOTOR
	
	RETURN



DEMORA_20ms
			MOVLW D'20'
			MOVWF CONT_2
	BUCLE	MOVLW D'250'
			MOVWF CONT_1
			
			NOP
			DECFSZ CONT_1,1
				GOTO $-.2
			BCF STATUS, Z
			DECFSZ CONT_2,1
				GOTO BUCLE
			RETURN


END